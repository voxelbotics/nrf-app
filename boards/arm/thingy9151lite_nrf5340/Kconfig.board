## boards/arm/thingy9151lite_nrf5340/Kconfig.board
```kconfig
# Thingy-9151-Lite NRF5340 board configuration

# Copyright (c) 2019-2020 Nordic Semiconductor ASA
# SPDX-License-Identifier: Apache-2.0

if SOC_NRF5340_CPUAPP_QKAA

config BOARD_THINGY9151LITE_NRF5340_CPUAPP
	bool "Thingy-9151-Lite nRF5340 Application MCU"

config BOARD_THINGY9151LITE_NRF5340_CPUAPP_NS
	bool "Thingy-9151-Lite nRF5340 Application MCU non-secure"

endif # SOC_NRF5340_CPUAPP_QKAA

config BOARD_THINGY9151LITE_NRF5340_CPUNET
	bool "Thingy-9151-Lite NRF5340 Network MCU"
	depends on SOC_NRF5340_CPUNET_QKAA
```

## boards/arm/thingy9151lite_nrf9161/Kconfig.board
```kconfig
# Thingy-9151-Lite NRF9161 board configuration

# Copyright (c) 2023 Nordic Semiconductor ASA
# SPDX-License-Identifier: Apache-2.0

if SOC_NRF9161_LACA

config BOARD_THINGY9151LITE_NRF9161
	bool "Thingy-9151-Lite NRF9161"

config BOARD_THINGY9151LITE_NRF9161_NS
	bool "Thingy-9151-Lite NRF9161 non-secure"

endif # SOC_NRF9161_LACA
```

## boards/arm/thingy9151lite_nrf9161/dts/bindings/nordic,thingy9151lite-nrf5340-reset.yaml
```yaml
# Copyright (c) 2023 Nordic Semiconductor ASA
# SPDX-License-Identifier: Apache-2.0

description: GPIO used to reset nRF5340 on Thingy-9151-Lite

compatible: "nordic,thingy9151lite-nrf5340-reset"

include: base.yaml

properties:
  status:
    required: true

  gpios:
    type: phandle-array
    required: true
    description: |
      GPIO to use as nRF5340 reset line: output in nRF9161, input in nRF5340.
```

## boards/arm/thingy9151lite_nrf9161/thingy9151lite_nrf9161_ns_defconfig
```kconfig
# SPDX-License-Identifier: Apache-2.0

CONFIG_SOC_SERIES_NRF91X=y
CONFIG_SOC_NRF9161_LACA=y
CONFIG_BOARD_THINGY9151LITE_NRF9161_NS=y

# Enable MPU
CONFIG_ARM_MPU=y

# Enable hardware stack protection
CONFIG_HW_STACK_PROTECTION=y

# Enable TrustZone-M
CONFIG_ARM_TRUSTZONE_M=y

# This Board implies building Non-Secure firmware
CONFIG_TRUSTED_EXECUTION_NONSECURE=y

# Enable GPIO
CONFIG_GPIO=y

# Enable PWM LED driver
CONFIG_PWM=y
CONFIG_LED_PWM=y

# Enable uart driver
CONFIG_SERIAL=y

# Enable console
CONFIG_CONSOLE=y
CONFIG_UART_CONSOLE=y

# Enable external flash
CONFIG_SPI=y
CONFIG_SPI_NOR=y
CONFIG_SPI_NOR_SFDP_DEVICETREE=y
CONFIG_PM_OVERRIDE_EXTERNAL_DRIVER_CHECK=y

# Configure modem antenna
CONFIG_MODEM_ANTENNA=y
CONFIG_MODEM_ANTENNA_AT_MAGPIO=""
```

## thingy9151lite_nrf9151_app/src/addons/Kconfig
```kconfig
#
# Copyright (c) 2024 Emcraft Systems
#
# SPDX-License-Identifier: Apache-2.0
#

config VCOM_TESTS
	bool "VCOM interface tests"
	default y

module = ADDONS
module-str = Addons integration layer
source "subsys/logging/Kconfig.template.log_config"
```

## thingy9151lite_nrf9151_app/src/addons/pmic/Kconfig
```kconfig
#
# Copyright (c) 2024 Emcraft Systems
#
# SPDX-License-Identifier: Apache-2.0
#

menuconfig PMIC
	bool "Enable PMIC module"
	default y

if PMIC

config PMIC_INIT_PRIORITY
	int "PMIC init priority"
	default 90
	help
		The Thingy-9151-Lite board contains an nPM1300 PMIC that needs to be configured to
		set up the power domains on the board correctly. This happens during sys_init,
		and the PMIC setup must happen before external devices are initialized in order.

config PMIC_IRQ
	bool "Enable PMIC interrupts"
	default y

rsource "Kconfig.pmic_regulator"
rsource "Kconfig.pmic_charger"

endif # PMIC

module = PMIC
module-str = pmic
source "subsys/logging/Kconfig.template.log_config"
```

## thingy9151lite_nrf9151_app/src/addons/pmic/Kconfig.pmic_charger
```kconfig
#
# Copyright (c) 2024 Emcraft Systems
#
# SPDX-License-Identifier: Apache-2.0
#

menuconfig PMIC_CHARGER
	bool "Enable PMIC charger module"
	select SENSOR
	default y

module = CHARGER
module-str = charger
source "subsys/logging/Kconfig.template.log_config"
```

## thingy9151lite_nrf9151_app/src/addons/pmic/Kconfig.pmic_regulator
```kconfig
#
# Copyright (c) 2024 Emcraft Systems
#
# SPDX-License-Identifier: Apache-2.0
#

menuconfig PMIC_REGULATOR
	bool "Enable PMIC regulator module"
	select REGULATOR
	default y

module = REGULATOR
module-str = regulator
source "subsys/logging/Kconfig.template.log_config"
```

## thingy9151lite_nrf9151_app/src/watchdog/Kconfig
```kconfig
#
# Copyright (c) 2021 Nordic Semiconductor
# Copyright (c) 2024 Emcraft Systems
#
# SPDX-License-Identifier: LicenseRef-Nordic-5-Clause
#

menuconfig WATCHDOG_APPLICATION
	bool "Application watchdog"
	select WATCHDOG
	default y

if WATCHDOG_APPLICATION

config WATCHDOG_APPLICATION_USE_NPM1300_WDT
	bool "Use nPM1300 watchdog"
	default n

config WATCHDOG_APPLICATION_USE_INTERNAL_WDT
	bool "Use internal watchdog"
	depends on !WATCHDOG_APPLICATION_USE_NPM1300_WDT
	default y if !WATCHDOG_APPLICATION_USE_NPM1300_WDT

config WATCHDOG_APPLICATION_TIMEOUT_MS
	int "Watchdog timeout in milliseconds"
	default 5000

config WATCHDOG_APPLICATION_FEED_PERIOD_MS
	int "Watchdog feed period in milliseconds"
	default 2500

endif # WATCHDOG_APPLICATION

module = WATCHDOG
module-str = Watchdog
source "subsys/logging/Kconfig.template.log_config"
```
